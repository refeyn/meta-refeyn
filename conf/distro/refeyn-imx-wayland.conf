## conf/distro/refeyn-imx-wayland.conf
```bitbake
require conf/distro/fsl-imx-wayland.conf

DISTRO = "refeyn-imx-wayland"
DISTRO_NAME = "Refeyn IMX Distro"
DISTRO_VERSION = "0.1.0"
```

## conf/distro/refeyn-wayland.conf
```bitbake
require conf/distro/tdx-xwayland.conf

DISTRO = "refeyn-wayland"
DISTRO_NAME = "Refeyn TDX Distro"

# Don't want XWayland
DISTRO_FEATURES:remove = " x11"
DISTRO_FEATURES:remove = " nfs"

# Disable patch status checking
ERROR_QA:remove = "patch-status"

# Do not commit build history
BUILDHISTORY_COMMIT = "0"

# Use a persistent log on the device
VOLATILE_LOG_DIR = "no"

DISTRO_FEATURES:append = " overlayfs"
DISTRO_FEATURES:remove = " bluetooth"
DISTRO_FEATURES:remove = " wifi"
DISTRO_FEATURES:remove = " 3g"
DISTRO_FEATURES:remove = " zeroconf"

DISTRO_VERSION = "26.1.0-dev${DATETIME}"
DISTRO_VERSION[vardepsexclude] = "DATETIME"

REPRODUCIBLE_TIMESTAMP_ROOTFS = "${@(int(time.mktime(time.strptime(d.getVar('DATETIME'),'%Y%m%d%H%M%S'))) if d.getVar('DATETIME') != '12341234' else '1')}"
REPRODUCIBLE_TIMESTAMP_ROOTFS[vardepsexclude] = "DATETIME"

INHERIT += "cve-check"
include cve-extra-exclusions.inc
```

## conf/machine/apalis-imx8-refeyn.conf
```bitbake
require conf/machine/apalis-imx8.conf

MACHINE_NAME = "Apalis-iMX8-refeyn"
UBOOT_CONFIG[sd] = "apalis-imx8-refeyn_defconfig,sdcard"

KERNEL_DEVICETREE += " \
    ${KERNEL_DTB_PREFIX}imx8qm-apalis-v1.1-generic-carrier-generic-aux.dtb \
    ${KERNEL_DTB_PREFIX}imx8qm-apalis-v1.1-tdx-ixora-13-generic-aux.dtb \
    ${KERNEL_DTB_PREFIX}imx8qm-apalis-v1.1-ec-asm-00037-01-generic-aux.dtb \
    ${KERNEL_DTB_PREFIX}imx8qm-apalis-v1.1-ec-asm-00037-01-ec-asm-00027-02.dtb \
    ${KERNEL_DTB_PREFIX}imx8qm-apalis-v1.1-ec-asm-00037-02-generic-aux.dtb \
    ${KERNEL_DTB_PREFIX}imx8qm-apalis-v1.1-ec-asm-00037-02-ec-asm-00027-02.dtb \
"
TEZI_EXTERNAL_KERNEL_DEVICETREE_BOOT = ""
```

## conf/machine/aquila-am69-refeyn-k3r5.conf
```bitbake
require conf/machine/aquila-am69-k3r5.conf

MACHINE_NAME = "Aquila-AM69-refeyn"
UBOOT_CONFIG[sd-r5] = "aquila-am69_r5_refeyn_defconfig,sdcard,spl/u-boot-spl.bin"
```

## conf/machine/aquila-am69-refeyn.conf
```bitbake
require conf/machine/aquila-am69.conf

MACHINE_NAME = "Aquila-AM69-refeyn"
MACHINEOVERRIDES =. "aquila-am69:"
UBOOT_CONFIG[sd] = "aquila-am69_a72_refeyn_defconfig,sdcard"

KERNEL_DEVICETREE += " \
    ${KERNEL_DTB_PREFIX}k3-am69-aquila-v1.0-tdx-dev-12-generic-aux.dtb \
    ${KERNEL_DTB_PREFIX}k3-am69-aquila-v1.0-generic-carrier-generic-aux.dtb \
    ${KERNEL_DTB_PREFIX}k3-am69-aquila-v1.0-ec-asm-00044-03-generic-aux.dtb \
    ${KERNEL_DTB_PREFIX}k3-am69-aquila-v1.0-ec-asm-00044-03-ec-asm-00048-02.dtb \
    ${KERNEL_DTB_PREFIX}k3-am69-aquila-v1.1-tdx-dev-12-generic-aux.dtb \
    ${KERNEL_DTB_PREFIX}k3-am69-aquila-v1.1-generic-carrier-generic-aux.dtb \
    ${KERNEL_DTB_PREFIX}k3-am69-aquila-v1.1-ec-asm-00044-03-generic-aux.dtb \
    ${KERNEL_DTB_PREFIX}k3-am69-aquila-v1.1-ec-asm-00044-03-ec-asm-00048-02.dtb \
"
TEZI_EXTERNAL_KERNEL_DEVICETREE_BOOT = ""
KERNEL_IMAGETYPE = "fitImage"
IMAGE_BOOT_FILES_REMOVE:append = " boot.scr-${MACHINE};boot.scr overlays.txt overlays/*;overlays/*"
```

## conf/machine/imx8qm-ec-asm-00014-01.conf
```bitbake
#@TYPE: Machine
#@NAME: i.MX 8QM EC-ASM-00014-01
#@SOC: i.MX8QM
#@DESCRIPTION: Refeyn i.MX 8QuadMax single board computer

MACHINEOVERRIDES =. "mx8:mx8qm:mx8qm-ec-asm-00014-01:"

require conf/machine/include/imx-base.inc
require conf/machine/include/arm/armv8a/tune-cortexa72-cortexa53.inc

IMX_DEFAULT_BSP = "nxp"

MACHINE_FEATURES += "pci optee bcm43455 bcm4356 nxp8997-pcie nxp9098-pcie"
MACHINE_FEATURES:append:use-nxp-bsp = " bcm4359"

# Don't include kernels in standard images
RRECOMMENDS:${KERNEL_PACKAGE_NAME}-base = ""
RDEPENDS:${KERNEL_PACKAGE_NAME}-image = ""

LOADADDR = ""

# We have to disable SERIAL_CONSOLE due to auto-serial-console
SERIAL_CONSOLES = "115200;ttyAMA0"

# we do not want to have getty running on tty1 as we run
# auto-serial-console there
USE_VT = "0"

KERNEL_DEVICETREE = " \
    freescale/imx8qm-ec-asm-00014-01.dtb \
"

UBOOT_MAKE_TARGET = \
    "${@bb.utils.contains('MACHINE_FEATURES', 'optee', '', \
                                                       'u-boot.bin', d)}"
SPL_BINARY = \
    "${@bb.utils.contains('MACHINE_FEATURES', 'optee', 'spl/u-boot-spl.bin', \
                                                       '', d)}"
IMX_DEFAULT_BOOTLOADER:use-nxp-bsp = "u-boot-imx"
IMX_DEFAULT_BOOTLOADER:use-mainline-bsp = "u-boot-fslc"

UBOOT_SUFFIX = "bin"

UBOOT_CONFIG ??= "sd"
UBOOT_CONFIG[sd]      = "imx8qm_ec_asm_00014_01_defconfig,sdcard"
# UBOOT_CONFIG[fspi]    = "imx8qm_ec_asm_00014_01_fspi_defconfig"
UBOOT_CONFIG[mfgtool] = "imx8qm_ec_asm_00014_01_defconfig"

IMX_BOOT_SEEK = "32"

IMAGE_BOOT_FILES += "hdmitxfw.bin hdmirxfw.bin dpfw.bin"

# Set ATF platform name
ATF_PLATFORM = "imx8qm"

IMXBOOT_TARGETS_SD = \
    "${@bb.utils.contains('MACHINE_FEATURES', 'optee', 'flash_linux_m4', \
                                                       'flash_regression_linux_m4', d)} \
     ${@bb.utils.contains('MACHINE_FEATURES', 'optee', 'flash_spl', \
                                                       'flash flash_ca72', d)}"
IMXBOOT_TARGETS_FSPI = \
    "${@bb.utils.contains('MACHINE_FEATURES', 'optee', 'flash_spl_flexspi', \
                                                       'flash_flexspi', d)}"
IMXBOOT_TARGETS = \
    "${@bb.utils.contains('UBOOT_CONFIG',      'fspi', '${IMXBOOT_TARGETS_FSPI}', \
                                                       '${IMXBOOT_TARGETS_SD}', d)}"
IMX_BOOT_SOC_TARGET = "iMX8QM"

PREFERRED_PROVIDER_imx-sc-firmware = "imx-sc-firmware-refeyn"
BOARD_TYPE = "ec-asm-00014-01"
```
